## package/crosvm/Config.in
```kconfig
config BR2_PACKAGE_CROSVM
    bool "crosvm"
    depends on BR2_PACKAGE_HOST_RUSTC_TARGET_ARCH_SUPPORTS
    select BR2_PACKAGE_HOST_RUSTC
    select BR2_PACKAGE_HOST_PKGCONF
    select BR2_PACKAGE_LIBCAP
    select BR2_PACKAGE_MINIJAIL
    help
      VMM originating from ChomeOS.

      https://chromium.googlesource.com/chromiumos/platform/crosvm/
```
